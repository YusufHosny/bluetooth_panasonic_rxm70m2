## sdkconfig.defaults
```kconfig
# Flash: 4MB chip, large single-app partition (~3MB for app)
CONFIG_ESPTOOLPY_FLASHSIZE_4MB=y
CONFIG_ESPTOOLPY_FLASHSIZE="4MB"
CONFIG_PARTITION_TABLE_SINGLE_APP_LARGE=y

# Bluetooth Classic / A2DP
CONFIG_BT_ENABLED=y
CONFIG_BTDM_CTRL_MODE_BR_EDR_ONLY=y
CONFIG_BT_CLASSIC_ENABLED=y
CONFIG_BT_BLUEDROID_ENABLED=y
CONFIG_BT_A2DP_ENABLE=y
CONFIG_BT_AVRC_ENABLED=y
CONFIG_BT_AVRC_CT_EN=y
CONFIG_BT_AVRC_TG_EN=y
CONFIG_BT_SPP_ENABLED=n
```
